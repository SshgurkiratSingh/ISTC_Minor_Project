#include <Arduino.h>
#include <ESP8266WiFi.h>
#include <PubSubClient.h>
#include <Adafruit_GFX.h>
#include <Adafruit_SSD1306.h>
#include <U8g2lib.h>

// ----------------------------- Configurations -------------------------------------//
#define LEDPIN D0
#define SWITCHBOARDPIN D3
#define WIFI_SSID "ConForNode1"
#define WIFI_PASSWORD "12345678"
#define MQTT_SERVER "ec2-35-170-242-83.compute-1.amazonaws.com"
#define MQTT_PORT 1883
#define TOTALTOPIC 1
#define OLED_TYPE 1

// Define OLED parameters based on the type
#if OLED_TYPE
  #define SCREEN_WIDTH 128
  #define SCREEN_HEIGHT 64
  #define SCREEN_I2C_ADDR 0x3C
  #define OLED_RST_PIN -1
  Adafruit_SSD1306 display(SCREEN_WIDTH, SCREEN_HEIGHT, &Wire, OLED_RST_PIN);
#else
  U8G2_SH1106_128X64_NONAME_F_SW_I2C display(U8G2_R0, D3, D4);
#endif

// Global Variables
WiFiClient espClient;
PubSubClient client(espClient);
String topicToSubscribe[TOTALTOPIC] = {"IoT/hall/TV"};
int currentTopicValue[TOTALTOPIC] = {0};


// Oled Config Starts Here ------------------


#define FRAME_DELAY (42)
#define FRAME_WIDTH (64)
#define FRAME_HEIGHT (64)
#define FRAME_COUNT (sizeof(frames) / sizeof(frames[0]))

void setupWifi();
void reconnectMQTT();
void mqttCallback(char* topic, byte* payload, unsigned int length);
void runAnimation();
void clearAnimation();

const byte PROGMEM frames[][512] = {
    {0, 0, 0, 0, 0, 0, 0, 0, 0, 0, 0, 0, 0,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 0, 0},
    {0, 0, 0, 0, 0, 0, 0, 0, 0, 0, 0, 0, 0,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 0, 0},
    {0, 0, 0, 0, 0, 0, 0, 0, 0, 0, 0, 0, 0,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 0, 0},
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    {0, 0, 0, 0, 0, 0, 0, 0, 0, 0, 0, 0, 0,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 0, 0}};
// -----------------------------Callback Declarations---------------------------//
void callback(char *topic, byte *payload, unsigned int length)
{
  String receivedTopic = String(topic);
#ifdef DEBUG_MODE
  Serial.print("Message arrived [");
  Serial.print(receivedTopic);
  Serial.print("] ");
#endif
  String msg;
  String payloadString = String((char *)payload);
  int value = payloadString.toInt();

      currentTopicValue[0] = value;
    
}

void setup() {
  Serial.begin(115200);
  setupWifi();

  client.setServer(MQTT_SERVER, MQTT_PORT);
  client.setCallback(mqttCallback);

  pinMode(LEDPIN, OUTPUT);
  pinMode(SWITCHBOARDPIN, OUTPUT);
  digitalWrite(LEDPIN, LOW);
  digitalWrite(SWITCHBOARDPIN, LOW);

#if OLED_TYPE
  display.begin(SSD1306_SWITCHCAPVCC, SCREEN_I2C_ADDR);
  display.clearDisplay(); 
  display.display();
#else
  display.begin();
  display.clearBuffer();  
  display.sendBuffer();   
#endif
}

int frame = 0;
/**
 * Runs the animation on the display.
 *
 * @param None
 *
 * @return None
 *
 * @throws None
 */
#if OLED_TYPE
  void runAnimation()
  {

  for (int i = 0; i < 85; i++)
  { 
    display.clearDisplay();
    display.drawBitmap(32, 0, frames[frame], FRAME_WIDTH, FRAME_HEIGHT, 1);
    display.drawBitmap
    display.display();
    frame = (frame + 1) % FRAME_COUNT;
    delay(FRAME_DELAY);
  }

  display.clearDisplay();
  display.setTextSize(1);
  display.setTextColor(WHITE);
  display.setCursor(0, 0);
  display.println("Made BY:");
  display.println("91, 92, 93, 94");
  display.println("143, 144, 145");
  display.println("162, 163, 164 , 165");
  display.display();
  delay(1000);
}
void clearAnimation()
{
  display.clearDisplay();
  display.display();
}
#else 
void runAnimation() {
  // for (int i = 0; i < 85; i++) {
  //   display.clearBuffer();
  //   // Corrected drawBitmap call with proper argument types and order
  //   display.drawBitmapP(0, 0, 128/8, 64, frames[frame]);
  //   display.sendBuffer();
  //   frame = (frame + 1) % FRAME_COUNT;
  //   delay(FRAME_DELAY);
  // }

  display.clearBuffer();
  display.setFont(u8g2_font_ncenB08_tr); // Example font, adjust as needed
  display.drawStr(0, 10, "Made BY:");
  display.drawStr(0, 20, "91, 92, 93, 94");
  display.drawStr(0, 30, "143, 144, 145");
  display.drawStr(0, 40, "162, 163, 164, 165");
  display.sendBuffer();
  delay(1000);
}



void clearAnimation() {
  display.clearBuffer();
  display.sendBuffer();
}

#endif

void loop() {
  if (!client.connected()) {
    reconnectMQTT();
  }
  client.loop();

  if (currentTopicValue[0] == 1) {
    runAnimation();
  } else {
    clearAnimation();
  }
}

void setupWifi() {
  WiFi.begin(WIFI_SSID, WIFI_PASSWORD);
  while (WiFi.status() != WL_CONNECTED) {
    delay(500);
    Serial.println("Connecting to WiFi...");
  }
  Serial.println("WiFi connected");
}

void reconnectMQTT() {
  while (!client.connected()) {
    Serial.print("Attempting MQTT connection...");
    if (client.connect("esp82661")) {
      Serial.println("connected");
      client.subscribe(topicToSubscribe[0].c_str());
    } else {
      Serial.print("failed, rc=");
      Serial.print(client.state());
      Serial.println(" try again in 5 seconds");
      delay(5000);
    }
  }
}

void mqttCallback(char* topic, byte* payload, unsigned int length) {
  payload[length] = '\0'; // Ensure null-termination
  String receivedTopic = String(topic);
  String payloadString = String((char *)payload);
  currentTopicValue[0] = payloadString.toInt();
  Serial.print("Message arrived [");

  Serial.print(receivedTopic);

  Serial.print("] ");

  Serial.println(payloadString);

  Serial.println(currentTopicValue[0]);

}

